## boards/csky/ats2875_legacy_evb/Kconfig.board
```kconfig
config BOARD_ATS2875_LEGACY_EVB
	bool "ATS2875 LEGACY Evaluate Board"
	depends on SOC_ATS2875_LEGACY
```

## boards/csky/ats2875h_charge_6/Kconfig.board
```kconfig
config BOARD_ATS2875H_CHARGE_6
	bool "ATS2875H Charge 6"
	depends on SOC_ATS2875H
```

## boards/csky/ats2875h_evb/Kconfig.board
```kconfig
config BOARD_ATS2875H_EVB
	bool "ATS2875H Evaluate Board"
	depends on SOC_ATS2875H
```

## ext/actions/bluetooth/Kconfig
```kconfig
# Kconfig - ACTIONS primitive options for sdk version 2.0

#
# Copyright (c) 2015 Intel Corporation
#
# Licensed under the Apache License, Version 2.0 (the "License");
# you may not use this file except in compliance with the License.
# You may obtain a copy of the License at
#
#     http://www.apache.org/licenses/LICENSE-2.0
#
# Unless required by applicable law or agreed to in writing, software
# distributed under the License is distributed on an "AS IS" BASIS,
# WITHOUT WARRANTIES OR CONDITIONS OF ANY KIND, either express or implied.
# See the License for the specific language governing permissions and
# limitations under the License.
#

config BT_STACK
	bool
	prompt "Blutooth Stack Support"
    select BLUETOOTH_PORTING
	select ACTS_TRANSCODE
	default n
	help
	This option enables actions Blutooth Stack.

source "ext/actions/bluetooth/bt_stack/Kconfig"

menuconfig BLUETOOTH
	bool
	prompt "BlueTooth"
	default n
	#select BT_MANAGER
	help
	This option enables actions bluetooth funcion.

config BT_MANAGER
    bool
    prompt "Bt Manager Support"
	select BT_SERVICE
	#select BT_STACK
	#select BLUETOOTH_PORTING
	select ACTS_TRANSCODE
    default n
    help
    This option enables bt manager.

config BT_SERVICE
	bool
	prompt "Blutooth Service Support"
	select THREAD_TIMER
	default n
	help
	This option enables actions Blutooth service.

config BT_DOUBLE_PHONE
    bool
    prompt "Bt double phone Support"
	depends on BT_MANAGER
    default n
    help
    This option enables Bt double phone manager.

config BT_DOUBLE_PHONE_EXT_MODE
    bool
    prompt "Bt double phone ext mode Support"
    depends on BT_DOUBLE_PHONE
    default n
    help
    This option enables Bt double phone ext mode Support.

config BT_DOUBLE_PHONE_PREEMPTION_MODE
    bool
    prompt "Bt double phone preemption mode Support"
    depends on BT_DOUBLE_PHONE
    default n
    help
    This option enables Bt double phone preemption mode Support.

config BT_DOUBLE_PHONE_TAKEOVER_MODE
    bool
    prompt "Bt double phone takeover mode Support"
    depends on BT_MANAGER
    default n
    help
    This option enables Bt double phone takeover mode Support.    

config BT_PHONE_FILTER_PROMPT_TONE
    bool
    prompt "Bt phone filter prompt tone Support"
    depends on BT_MANAGER
    default n
    help
    This option enables Bt phone filter prompt tone Support.

config BT_DOUBLE_PHONE_TAKEOVER_POLICY
    int
    prompt "Bt double phone takeover policy"
    default 1
    help
    This option enables Bt double phone takeover policy.

config MUTI_POINT_USER_PAUSE_POLICY
	int
	prompt "1: When user press pause button, it is deemed to be device stop playing"
	default 0

config BT_PHONE_ROLE_MASTER
    bool
    prompt "Set bt phone role to master"
	depends on BT_MANAGER
    default n
    help
    This option enables Set bt phone role to master.

config BT_PHONE_ROLE_SLAVE
    bool
    prompt "Set bt phone role to slave"
	depends on BT_MANAGER
    default n
    help
    This option enables Set bt phone role to slave.
    
config BT_BLE
    bool
    prompt "Bt Ble Support"
	depends on BT_MANAGER
	depends on BT_LE_ATT
    default n
    help
    This option enables bt manager.


config BT_AVRCP_GET_ID3
    bool
    prompt "Bt avrcp get ID3 Support"
    depends on BT_MANAGER
    default n
    help
    This option enables Bt avrcp get ID3 .


config BT_A2DP_AAC
    bool
    prompt "Bt a2dp aac Support"
	depends on BT_MANAGER
    default n
    help
    This option enables bt a2dp aac.

config BT_A2DP_LDAC
    bool
    prompt "Bt a2dp ldac Support"
	depends on BT_MANAGER
    default n
    help
    This option enables bt a2dp ladc.
    
config BT_A2DP_MAX_BITPOOL
    int
    prompt "Bt a2dp bit pool config"
	depends on BT_A2DP
    default 53
    help
    This option enables bt a2dp bit pool.

config BT_DEV_NAME
    string
    prompt "bt device name"
    depends on BT_MANAGER
    help
    This option specifies bt device classic name

config TWS
    bool
    prompt "bt manager Support tws"
	depends on BT_MANAGER
    default n
    help
    This option enables bt tws.

config TWS_MONO_MODE
    bool
    prompt "bt manager Support tws mono mode"
	depends on TWS
    default n
    help
    This option enables bt tws mono mode.

config TWS_BACKGROUND_BT
    bool
    prompt "bt manager Support local tws support background bt"
	depends on TWS
    default n
    help
    This option enables local tws support background bt.

config BT_HFP_TWS
    bool
    prompt "bt manager Support hfp tws"
    depends on TWS
    default n
    help
    This option enables bt hfp tws.

config CSB
    bool
    prompt "bt manager Support csb"
	depends on BT_MANAGER
    default n
    help
    This option enables bt csb.

config MGR_TEST_SAMPLE
    bool
    prompt "bt manager test sample"
	depends on BT_MANAGER
    default n
    help
    This option enables bt manager test sample.

config BT_TWS_US281B
    bool
    prompt "Whether adaptive to us281b tws"
    default n
    depends on BT_SERVICE
    help
    This option set whether adaptive to us281b tws

config BT_LE_AUDIO_LOW_LATENCY
	bool
	prompt "BT LE Audio low latency mode Support"
	depends on BT_MANAGER
	depends on BT_LE_ATT
	default n
	help
	  This option enables bt le audio low latency mode.

config BT_LE_AUDIO_BUF_SIZE
	int
	prompt "BT LE Audio Buffer Size"
	depends on BT_MANAGER
	default 4096
	help
	  This option defines buffer size for bt le audio.

config BT_LE_AUDIO_ENCRYPT
	bool
	prompt "BT LE Audio Service Encryption Support"
	depends on BT_MANAGER
	default n
	help
	  This option enables bt le audio service encryption.

config BT_ASCS_SERVICE
	bool
	prompt "BT LE ASCS Service Support"
	depends on BT_MANAGER
	default n
	help
	  This option enables bt le ascs service.

config BT_CSIS_SERVICE
	bool
	prompt "BT LE CICS Service Support"
	depends on BT_MANAGER
	default n
	help
	  This option enables bt le cics service.

config BT_MCS_SERVICE
	bool
	prompt "BT LE MCS Service Support"
	depends on BT_MANAGER
	default n
	help
	  This option enables bt le mcs service.

config BT_MICS_SERVICE
	bool
	prompt "BT LE MICS Service Support"
	depends on BT_MANAGER
	default n
	help
	  This option enables bt le mics service.

config BT_PACS_SERVICE
	bool
	prompt "BT LE AICS Service Support"
	depends on BT_MANAGER
	default n
	help
	  This option enables bt le aics service.

config BT_TBS_SERVICE
	bool
	prompt "BT LE TBS Service Support"
	depends on BT_MANAGER
	default n
	help
	  This option enables bt le tbs service.

config BT_VCS_SERVICE
	bool
	prompt "BT LE VCS Service Support"
	depends on BT_MANAGER
	default n
	help
	  This option enables bt le vcs service.

config BT_CAS_SERVICE
	bool
	prompt "BT LE CAS Service Support"
	depends on BT_MANAGER
	default n
	help
	  This option enables bt le cas service.

config BT_AUDIO_VND_SERVICE
	bool
	prompt "BT LE Audio Vendor Service Support"
	depends on BT_MANAGER
	default n
	help
	  This option enables bt le audio vendor service.

config BT_TMAS_SERVICE
	bool
	prompt "BT LE TMAS Service Support"
	depends on BT_MANAGER
	default n
	help
	  This option enables bt le tmas service.

config BT_BASS_SERVICE
	bool
	prompt "BT LE BASS Service Support"
	depends on BT_MANAGER
	default n
	help
	  This option enables bt le bass service.

config BT_PAWR
	bool
	prompt "BT PER ADV WITH RSP"
	depends on BT_MANAGER
	default n
	help
	  This option enables bt pawr.	  

config GFP_PROFILE
	bool
	prompt "GFP Support"
	default n
	help
	This option enable or disable gfp

config BT_GATT_OVER_BR
    bool "BT GATT OVER BR Support"
    default n
    help
    This option enables bt gatt over br.

 config BT_VENDOR_ID
    hex
    prompt "BT Vendor id"
    depends on BT_MANAGER
    default 0x03E0
    help
        This option defines Vendor ID bt device id.

config BT_PRODUCT_ID
	hex
	prompt "BT Product id"
	depends on BT_MANAGER
	default 0x0001
	help
		This option defines Product ID bt device id.

config BT_LEATWS
	bool
	prompt "BT LEATWS Support"
	depends on BT_MANAGER
	default n
	help
	  This option enables bt leatws.

config BT_LEATWS_FL
	bool
	prompt "BT LEATWS Set Left Channel"
	depends on BT_LEATWS
	default n
	help
	  This option bt leatws set left channel.

config BT_LEATWS_FR
	bool
	prompt "BT LEATWS Set Right Channel"
	depends on BT_LEATWS
	default n
	help
	  This option bt leatws set right channel.

config BT_LETWS
  bool
  prompt "enable letws"
	depends on BT_MANAGER
  default n

config BT_PER_ADV_SYNC_TRANSFER_SENDER
  bool   
  depends on BT_MANAGER
  default n
    
```

## ext/actions/media/Kconfig
```kconfig
# Kconfig - Actions media player

#
# Copyright (c) 2016 Actions Corporation
#
# SPDX-License-Identifier: Apache-2.0
#

menuconfig MEDIA
	bool
	prompt "media"
	select MEDIA_PLAYER
	default n
	help
	This option enables actions media

config MEDIA_PLAYER
	bool
	prompt "media player Support"
	depends on MEDIA
	select MEDIA_SERVICE
	select STREAM
	select RINGBUFF_STREAM
	default n
	help
	This option enables actions media player

config MEDIA_SERVICE
	bool
	prompt "Media Service Support"
	select THREAD_TIMER
	select AUDIO_SYSTEM
	default n
	help
	This option enables actions Media service.

config MEDIASRV_PRIORITY
    int
    prompt "Media Service Thread Priority"
    default 4
    depends on MEDIA_SERVICE
    help
    This option set audio thread priority

config MEDIASRV_STACKSIZE
    int
    prompt "Media Service Thread Stack Size"
    default 2048
    depends on MEDIA_SERVICE
    help
    This option set stack size for audio service thread


config MEDIA_EFFECT
	bool
	prompt "media effect Support"
	depends on MEDIA_PLAYER
	default n
	help
	This option enables actions media effect

config MEDIA_EFFECT_OUTMODE
	int
	prompt "media effect output mode Support"
	depends on MEDIA_PLAYER
	default 0
	help
	This option enables actions media output mode

config MUSIC_EFFECT
	bool
	prompt "music effect Support"
	depends on MEDIA_PLAYER
	select MEDIA_EFFECT
	select MUSIC_DAE
	# select MUSIC_DAE_FADE
	default n
	help
	This option enables actions music effect

config MUSIC_DRC_EFFECT
	bool
	prompt "music drc effect Support"
	depends on MUSIC_EFFECT
	select MEDIA_EFFECT
	default n
	help
	This option enables actions music drc effect

config MUSIC_EXTERNAL_EFFECT
	bool
	prompt "music externl effect Support"
	depends on MEDIA_PLAYER
	select MUSIC_EFFECT
	default n
	help
	This option enables external music effect

config MUSIC_MULTI_DEVICE_ALIGN_TO_RESET_CLK
    bool
    prompt "reset i2s/dac clk for bis/tws muti-device align"
    default n

config MUSIC_EXTERNAL_EFFECT_MIC_STREAM
	bool
	prompt "music externl effect mic stream"
	depends on MEDIA_PLAYER
	select MUSIC_EXTERNAL_EFFECT
	default n
	help
	This option enables external music effect mic stream

config VOICE_EFFECT
	bool
	prompt "voice effect Support"
	depends on MEDIA_EFFECT
	default n
	help
	This option enables actions voice effect

config AEC_TAIL_LENGTH
	int
	prompt "AEC tail length config"
	depends on VOICE_EFFECT
	default 48
	help
	This option set AEC tail length config

config 3NODS_PRO_EV_HW_2
    bool
    prompt "3 nods pre EV hardware 2"
    depends on C_LOGIC_MCU
    default n
config TOLY_EV
    bool
    prompt "TOLY EV hardware 1"
    depends on C_LOGIC_MCU
    default n	
config BATTERY_SECURITY
    bool
    prompt "HM battry security"
   depends on C_LOGIC_MCU
   # depends on BUILD_PROJECT_HM_DEMAND_CODE
    default n
config HM_CHARGE_WARNNING_ACTION_FROM_X4
    bool
    prompt "HM charge warnning actions as X4"
    depends on BUILD_PROJECT_HM_DEMAND_CODE
    default n	
source "ext/actions/media/libal/Kconfig"
source "ext/actions/media/libwltmcu/Kconfig"
```

## ext/actions/media/libwltmcu/Kconfig
```kconfig
config C_LOGIC_MCU_MSPM0L
    bool
    prompt "use logic mcu MSPM0L"
    depends on C_LOGIC_MCU
    default n

config C_LOGIC_MCU_LS8A10049T
    bool
    prompt "use logic IC LS8A10049T"
    depends on C_LOGIC_MCU
    default n

config C_LOGIC_MCU_AW9523B
    bool
    prompt "use EXTERN IO IC AW9523B"
    depends on C_LOGIC_MCU
    default n
```

## ext/actions/ota/Kconfig
```kconfig
# Kconfig - Actions ota

#
# Copyright (c) 2016 Actions Corporation
#
# SPDX-License-Identifier: Apache-2.0
#

menuconfig OTA
	bool
	prompt "ota"
	default n
	help
	This option enables actions ota

if OTA
	config OTA_LEGACY_REQ_SIZE
		prompt "ota legacy req size"
		bool
		default n
		help
			Enable this option to support legracy OTA app.
endif
```

## samples/bt_speaker/src/Kconfig
```kconfig
# Kconfig - ACTIONS primitive options for sdk version 2.0
#
# Copyright (c) 2023 Actions Semiconductor Co., Ltd
# SPDX-License-Identifier: Apache-2.0
#

menu "bt_speaker App"

config APP_PRIORITY
    int
    prompt "App Thread Priority"
    default 10
    help
    This option set app thread priority

config APP_STACKSIZE
    int
    prompt "App Thread Stack Size"
    default 2048
    help
    This option set stack size for app thread

config BT_MUSIC_APP
	  bool
	  prompt "BT MUSIC App Support"
	  default n

config AURACAST
	  bool
	  prompt "Auracast Support"
	  default n

config BT_DISABLE_PAIR_MODE
	  bool
	  prompt "disable pair mode"
	  default n

config DSP_COMPUTE_COMPLEXITY
	int
	prompt "DSP compute complexity"
	default 2
	help
	  Set the compute compexity level of DSP, the bigger the higer complexity.
	  0 - Empty(thirdpart DSP), 1-low, 2-normal, 3-high
config BUILD_PROJECT_HM_DEMAND_CODE
	bool
	prompt "build project hm demand code"
	depends on BOARD_ATS2875H_CHARGE_6
	default n

config SPI_SWITCH
	bool
	prompt "Switch SPI on/off"
	default n

config SPI_SWITCH_BY_GPIO
	bool
	prompt "Switch SPI on/off"
	default n

  config C_TEST_BATT_MACRO
    bool
    prompt "enable test battery"
    default n
config AUARCAST_FILTER_POLICY_H
    bool
    prompt "auarcast filter policy H"
    default n

config BT_LE_AUDIO
    bool
    prompt "enable leaudio"
    default n

config BT_LE_AUDIO_CALL
    bool
    prompt "enable leaudio call"
    default n

config EXTERNAL_DSP_DELAY
	  int
	  prompt "external DSP delay"
	  default 0
	  help

config USER_PAUSE_POLICY
	  bool
	  prompt "different policy when user pause.player will be stopped immediately when user pause if this macro config"
	  default n

config BT_LETWS
    bool
    prompt "enable letws"
    default n

config HM_FLIP_SERIES
    bool
    prompt "harman filp series"
    default n

config HM_CHARGE_SERIES
    bool
    prompt "harman charge series"
    default n

menu "App Configuration"

source "samples/bt_speaker/src/main/Kconfig"
source "samples/bt_speaker/src/tool/Kconfig"

source "samples/bt_speaker/src/ota/Kconfig"
source "samples/bt_speaker/src/usound/Kconfig"
source "samples/bt_speaker/src/demo/Kconfig"
source "samples/bt_speaker/src/audio_input/Kconfig"
source "samples/bt_speaker/src/charger/Kconfig"

source "samples/bt_speaker/src/charge_6/Kconfig"
source "samples/bt_speaker/src/selfapp/Kconfig"
source "samples/bt_speaker/src/data_analy/Kconfig"

endmenu

endmenu
```

## samples/bt_speaker/src/bmr/Kconfig
```kconfig
config BROCAST_SAFE_LIMIT_VOLUME
    int
    prompt "Brocast receiver safe volume limit level"
    default 0
    help
    This option set the safe volume limit level
```

## samples/bt_speaker/src/charge_6/Kconfig
```kconfig
source "samples/bt_speaker/src/charge_6/src/Kconfig"

config C_I2STX_KEEP_OPEN
    bool
    prompt "enable i2stx keep open"
    depends on AUDIO_OUTPUT_I2S
    default n
    
```
