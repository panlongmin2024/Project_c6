## samples/bt_speaker/src/charge_6/src/Kconfig
```kconfig
source "samples/bt_speaker/src/charge_6/src/driver/Kconfig"
source "samples/bt_speaker/src/charge_6/src/external_dsp/Kconfig"
#source "samples/bt_speaker/src/charge_6/src/logic_mcu/Kconfig"
source "samples/bt_speaker/src/charge_6/src/shell/Kconfig"
source "samples/bt_speaker/src/charge_6/src/pd/Kconfig"

config C_EXTERNAL_DSP
    bool
    prompt "use external dsp"
    default n

config C_LOGIC_MCU
    bool
    prompt "use logic mcu"
    default n

config C_SHELL
    bool
    prompt "use shell"
    default n
```

## samples/bt_speaker/src/charge_6/src/ats_cmd_wlt/Kconfig
```kconfig
config WLT_ATS_ENABLE
    bool
    prompt "enable wlt factory test"
    default n
```

## samples/bt_speaker/src/charge_6/src/driver/Kconfig
```kconfig
config C_AMP
	bool
	prompt "enable AMP"
	default n

config C_AMP_TAS5828M
    bool
    prompt "enable AMP TAS5828M"
    depends on C_AMP
    default n

config C_AMP_TAS5828M_NAME
    string
    prompt "AMP_TAS5828M name"
    depends on C_AMP
    default "AMP_TAS5828M_NAME"


config C_AMP_AW85828
    bool
    prompt "enable AMP AW85828"
    depends on C_AMP
    default n

config C_AMP_AW85828_NAME
    string
    prompt "AMP_AW85828 name"
    depends on C_AMP
    default "AMP_AW85828_NAME"    

config C_PD
    bool
    prompt "enable PD"
    default n

config C_PD_TPS65992
    bool
    prompt "enable PD TPS65992"
    depends on C_PD
    default n
config C_PD_MPS52002
    bool
    prompt "enable PD MPS52002"
    depends on C_PD
    default n
```

## samples/bt_speaker/src/charge_6/src/external_dsp/Kconfig
```kconfig
config C_EXTERNAL_DSP_ATS3615
    bool
    prompt "use external dsp"
    depends on C_EXTERNAL_DSP
    default n

config USE_EXT_DSP_VOLUME_GAIN
    bool
    prompt "EXT_DSP_VOLUME_GAIN"
    default n
```

## samples/bt_speaker/src/charge_6/src/shell/Kconfig
```kconfig
config C_USER_SHELL
    bool
    prompt "use user shell"
    depends on C_SHELL
    default n

config C_I2C_SHELL
    bool
    prompt "use i2c shell"
    depends on C_SHELL 
    default n

config C_GPIO_SHELL
    bool
    prompt "use gpio shell"
    depends on C_SHELL 
    default n
```

## samples/bt_speaker/src/selfapp/Kconfig
```kconfig
config BT_SELF_APP
    bool "support self_app protocol"
    default n
    select BT_BLE
    select BT_GATT_OVER_BR
    select BT_SELFAPP_ADV
    select BT_ADV_MANAGER
    select FIRMWARE_VERSION
    help
    This option support self_app protocol.

config OTA_SELF_APP
    bool "support ota by self_app"
    default y
    depends on OTA_APP
    depends on BT_SELF_APP
    help
    This option would auto enabled only when OTA_APP and BT_SELF_APP are both enabled.

config BT_SELFAPP_ADV
    bool "BT SELFAPP Advertising Support"
    default n
    help
    This option enables bt selfapp advertising.

config LOGSRV_SELF_APP
    bool "support log_service by self_app"
    default y
    depends on BT_SELF_APP
    help
    This option would auto enabled only when logservice and BT_SELF_APP are both enabled.
```

## samples/bt_speaker/src/usound/Kconfig
```kconfig
# Kconfig - ACTIONS primitive options for sdk version 2.0

#
# Copyright (c) 2023 Actions Semiconductor Co., Ltd
# SPDX-License-Identifier: Apache-2.0
#

config USOUND_APP
	bool
	prompt "USOUND App Support"
	depends on USB_AUDIO_SOURCESINK && USB_DEVICE_HID
	depends on  MEDIA_PLAYER
	select STREAM
	select RINGBUFF_STREAM
	default n
	help
	This option enables or disable the usb audio app.

config USOUND_MIC
	bool
	prompt "USOUND OUT"
	depends on USOUND_APP
	select SUPPORT_USB_AUDIO_SOURCE 
	default n
	help
	This option enables or disable the usb audio out.

config USOUND_MEETING_MODE
	bool
	prompt "USOUND MEETING mode"
	depends on USOUND_APP
	select SUPPORT_USB_AUDIO_SOURCE
	select AEC_REF_HW_MODE 
	default n
	help
	This option enables or disable the usb meeting audio out.

config USOUND_BROADCAST_SUPPROT
	bool
	prompt "USOUND Broadcast Support"
	depends on USOUND_APP
	default n
	help
	This option enables or disable usound broadcast.
```

## samples/usb_device/src/Kconfig
```kconfig
# Kconfig - ACTIONS primitive options for sdk version 2.0
# 
# Copyright (c) 2023 Actions Semiconductor Co., Ltd
# SPDX-License-Identifier: Apache-2.0
#

menu "bt_speaker App"

config APP_PRIORITY
    int
    prompt "App Thread Priority"
    default 10
    help
    This option set app thread priority

config APP_STACKSIZE
    int
    prompt "App Thread Stack Size"
    default 2048
    help
    This option set stack size for app thread

menu "App Configuration"

#source "samples/bt_speaker/src/main/Kconfig"

endmenu

endmenu
```
